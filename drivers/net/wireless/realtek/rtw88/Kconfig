## drivers/net/wireless/realtek/rtw88/Kconfig
```kconfig
config RTW8723DU
    tristate "Realtek 8723DU USB WiFi driver"
    depends on USB && WLAN_VENDOR_REALTEK
    select MAC80211
    help
      This module adds support for the Realtek 8723DU USB WiFi driver.

      If you choose to build it as a module, it will be called rtw_8723du.
```
